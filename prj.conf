## CMakeLists.txt
```
# Robotic Dog - legs firmware (Teensy 4.1, Zephyr RTOS, C++20)
cmake_minimum_required(VERSION 3.20.0)

find_package(Zephyr REQUIRED HINTS $ENV{ZEPHYR_BASE})
project(robotic_dog_legs)

target_sources(app PRIVATE
    src/main.cpp
)
```

## prj.conf
```kconfig
# Robotic Dog - legs firmware configuration (Teensy 4.1, Zephyr v4.4)

# ---- C++20 --------------------------------------------------------------------
CONFIG_CPP=y
CONFIG_STD_CPP20=y
# Full C++ standard library: std::array, std::span, std::string, <algorithm>, ...
CONFIG_REQUIRES_FULL_LIBCPP=y

# ---- Floating point -----------------------------------------------------------
# The Teensy 4.1 board leaves the hardware FPU off; without this, float math is
# done in software. FPU_SHARING saves FPU registers when threads switch.
CONFIG_FPU=y
CONFIG_FPU_SHARING=y

# ---- LED ----------------------------------------------------------------------
CONFIG_GPIO=y

# ---- Console over the Teensy's USB cable (shows up as a COM port) --------------
# printk() output goes here. Same settings as Zephyr's cdc-acm-console snippet;
# app.overlay points the console at this USB serial port instead of the
# board's default console UART.
CONFIG_USB_DEVICE_STACK_NEXT=y
CONFIG_CDC_ACM_SERIAL_INITIALIZE_AT_BOOT=y
CONFIG_SERIAL=y
CONFIG_CONSOLE=y
CONFIG_UART_CONSOLE=y
CONFIG_UART_LINE_CTRL=y
```

## app.overlay
```dts
/*
 * Robotic Dog - legs firmware devicetree overlay (Teensy 4.1)
 *
 * Sends the Zephyr console (printk + logging) to a USB serial port on the
 * Teensy's micro-USB connector instead of the board's default console UART
 * (pin table: Zephyr's Teensy 4 board documentation).
 * Same as Zephyr's cdc-acm-console snippet.
 */

/ {
	chosen {
		zephyr,console = &cdc_acm_uart0;
		zephyr,shell-uart = &cdc_acm_uart0;
	};
};

&zephyr_udc0 {
	cdc_acm_uart0: cdc_acm_uart0 {
		compatible = "zephyr,cdc-acm-uart";
	};
};
```

## src/main.cpp
```c
// Robotic Dog - legs firmware: blink test
// Board: Teensy 4.1   RTOS: Zephyr   Language: C++20
//
// Turns the orange LED on and off and prints each change on the USB serial
// port. If the LED blinks and the lines appear, your setup works.

#include <zephyr/kernel.h>
#include <zephyr/drivers/gpio.h>
#include <zephyr/sys/printk.h>

static_assert(__cplusplus >= 202002L, "Build as C++20 (CONFIG_STD_CPP20=y in prj.conf)");

namespace {

constexpr int kBlinkMs = 500; // how long the LED stays on, then off

// Orange LED, from the board's devicetree alias "led0"
const gpio_dt_spec led = GPIO_DT_SPEC_GET(DT_ALIAS(led0), gpios);

} // namespace

int main()
{
    if (!gpio_is_ready_dt(&led)) {
        printk("ERROR: the LED is not ready\n");
        return 0;
    }
    gpio_pin_configure_dt(&led, GPIO_OUTPUT_INACTIVE);

    for (bool on = true;; on = !on) {
        gpio_pin_set_dt(&led, on);
        printk("LED %s (%lld ms)\n", on ? "on " : "off", static_cast<long long>(k_uptime_get()));
        k_msleep(kBlinkMs);
    }
}
```
